## meta-inventec/meta-cxl/conf/layer.conf
```bitbake
# We have a conf and classes directory, add to BBPATH
BBPATH .= ":${LAYERDIR}"

# We have recipes-* directories, add to BBFILES
BBFILES += "${LAYERDIR}/recipes-*/*/*.bb \
            ${LAYERDIR}/recipes-*/*/*.bbappend"

BBFILE_COLLECTIONS += "cxl"
BBFILE_PATTERN_cxl = "^${LAYERDIR}/"
BBFILE_PRIORITY_cxl = "7"
LAYERSERIES_COMPAT_cxl = "honister kirkstone"
```

## meta-inventec/meta-purnell/conf/layer.conf
```bitbake
# We have a conf and classes directory, add to BBPATH
BBPATH .= ":${LAYERDIR}"

# We have recipes-* directories, add to BBFILES
BBFILES += "${LAYERDIR}/recipes-*/*/*.bb \
            ${LAYERDIR}/recipes-*/*/*.bbappend"

BBFILE_COLLECTIONS += "purnell"
BBFILE_PATTERN_purnell = "^${LAYERDIR}/"
BBFILE_PRIORITY_purnell = "7"
LAYERSERIES_COMPAT_purnell = "honister kirkstone"
```

## meta-inventec/meta-superion/conf/machine/superion.conf
```bitbake
KMACHINE = "aspeed"
KERNEL_DEVICETREE = "${KMACHINE}-bmc-inventec-${MACHINE}.dtb"

require conf/machine/include/ast2600.inc
require conf/machine/include/obmc-bsp-common.inc
require conf/machine/include/inventec.inc

UBOOT_MACHINE = "superion-ast2600_defconfig"
UBOOT_DEVICETREE = "ast2600-superion"
SOCSEC_SIGN_ENABLE = "0"

# Overwrite flash layout
FLASH_SIZE = "67712"
FLASH_UBOOT_SPL_SIZE = "64"
FLASH_UBOOT_OFFSET = "0"
FLASH_KERNEL_OFFSET = "21632"
FLASH_ROFS_OFFSET = "30848"
FLASH_RWFS_OFFSET = "3200"

# PFR settings
# The size of raw binary image. The value of PFR_IMAGE_SIZE is usally the size of BMC
# firmware flash. PFM image, BMC firmware, and signed capsule will be stored in the raw
# binary image according to the partition offset.
PFR_IMAGE_SIZE = "262144"

# PFM_OFFSET_PAGE The start offset of PFM in BMC flash for storing PFM (Platform firmware
# manifest) binary
# 0x000E0000
PFM_OFFSET_PAGE = "896"

# The start offset of recovery image for storing signed recovery capsule.
# 0x04220000
RC_IMAGE_PAGE = "67712"

# The file name of pfr manifest file. The file includes protection information of each flash
# partition, and whitelist commands of i2c buses.
PFR_MANIFEST = "pfr_manifest_ast2600_superion.json"

# The parameter tells signing utility the signing algorithm of root keys
# 1 = SHA256, 2 = SHA384
PFR_SHA = "2"

# PFR image build major version, range is 0 - 255
PFR_BUILD_VER_MAJ = "0"

# PFR image build major version, range is 0 - 255
PFR_BUILD_VER_MIN = "2"
```
